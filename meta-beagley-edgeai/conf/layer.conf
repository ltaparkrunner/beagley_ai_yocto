## meta-beagley-edgeai/conf/layer.conf
```bitbake
BBPATH .= ":${LAYERDIR}"

BBFILES += "${LAYERDIR}/recipes-*/*/*.bb \
            ${LAYERDIR}/recipes-*/*/*.bbappend"

BBFILE_COLLECTIONS += "beagley-edgeai"
BBFILE_PATTERN_beagley-edgeai = "^${LAYERDIR}/"
BBFILE_PRIORITY_beagley-edgeai = "10"

LAYERDEPENDS_beagley-edgeai = "core"
LAYERSERIES_COMPAT_beagley-edgeai = "scarthgap"
```
